## package/backports/Config.in
```kconfig
config BR2_PACKAGE_BACKPORTS
	bool "backports"
	help
	  The backports package includes many Linux drivers from recent
	  kernels, backported to older ones.
```

## package/gstreamermm/Config.in
```kconfig
config BR2_PACKAGE_GSTREAMERMM
	bool "gstreamermm"
	select BR2_PACKAGE_GLIBMM
	select BR2_PACKAGE_GSTREAMER1
	select BR2_PACKAGE_GST1_PLUGINS_BASE
	select BR2_PACKAGE_GST1_PLUGINS_GOOD
	select BR2_PACKAGE_LIBXMLPP
	select BR2_PACKAGE_LIBGLIB2
	select BR2_PACKAGE_LIBSIGC
	depends on BR2_INSTALL_LIBSTDCPP
	depends on BR2_TOOLCHAIN_GCC_AT_LEAST_4_8 # C++11
	depends on BR2_USE_WCHAR # libglib2
	depends on BR2_TOOLCHAIN_HAS_THREADS # libglib2
	depends on BR2_USE_MMU # libglib2
	help
	  The GStreamerMM package is a set of C++ bindings for GStreamer

	  http://www.gstreamer.org/
	  
comment "gstreamermm needs a toolchain w/ C++, wchar, threads, gcc >= 4.8"
	depends on BR2_USE_MMU
	depends on !BR2_TOOLCHAIN_GCC_AT_LEAST_4_8 || !BR2_USE_WCHAR \
|| !BR2_INSTALL_LIBSTDCPP || !BR2_TOOLCHAIN_HAS_THREADS
```

## package/nginx-rtmp-module/Config.in
```kconfig
config BR2_PACKAGE_NGINX_RTMP_MODULE
	bool "nginx-rtmp-module"
	depends on BR2_PACKAGE_NGINX
	select BR2_PACKAGE_NGINX_HTTP_SSL_MODULE
	select BR2_PACKAGE_RTMPDUMP
	help
      RTMP Modules for NGINX
```

## package/nttv-server/Config.in
```kconfig
config BR2_PACKAGE_NTTV_SERVER
	bool "nttv-server"
	depends on BR2_INSTALL_LIBSTDCPP 
	depends on BR2_TOOLCHAIN_USES_GLIBC # glib
	depends on BR2_PACKAGE_GSTREAMER1 # gstream
	depends on BR2_PACKAGE_LIBSIGC # SIGCPP
        depends on BR2_PACKAGE_PROTOBUF # protobuf
	depends on BR2_PACKAGE_LIBGLIB2 # glib
        depends on BR2_PACKAGE_ZEROMQ # zmq
        depends on BR2_PACKAGE_CPPZMQ #cppzmq
        depends on BR2_PACKAGE_GPSD #gpsd
        depends on BR2_PACKAGE_PAHO_MQTT_CPP
      

	help
	  Kopis's NTtv Server.

comment "NTtv Server needs a toolchain w/ C++ and buncha other stuff"
	depends on !BR2_INSTALL_LIBSTDCPP
```

## package/nttv-sys-monitor-app-legacy/Config.in
```kconfig
config BR2_PACKAGE_NTTV_SYS_MONITOR_APP_LEGACY
	bool "nttv-sys-monitor-app-legacy"
	depends on BR2_INSTALL_LIBSTDCPP
	help
	  Kopis's NTTV SYS MON LEGACY APP
	  -\__(o_o)__/-
	  --End help message--

comment "Sys Mon App needs a toolchain w/ C++"
	depends on BR2_INSTALL_LIBSTDCPP
```

## package/nttv-sys-monitor-app-v3/Config.in
```kconfig
config BR2_PACKAGE_NTTV_SYS_MONITOR_APP_V3
	bool "nttv-sys-monitor-app-v3"
	select BR2_PACKAGE_ZEROMQ
	depends on BR2_PACKAGE_LIBPTHREAD_STUBS # pthread?
	depends on BR2_INSTALL_LIBSTDCPP # zeromq, protobuf
	help
	  Kopis's NTTV SYS MON APP
	  -\__(o_o)__/-
	  --End help message--

comment "Sys Mon App 3 needs a toolchain w/ C++"
	depends on BR2_INSTALL_LIBSTDCPP
```

## package/paho-mqtt-cpp/Config.in
```kconfig
config BR2_PACKAGE_PAHO_MQTT_CPP
	bool "paho-mqtt-cpp"
	depends on !BR2_STATIC_LIBS  # dlopen()
	depends on BR2_PACKAGE_PAHO_MQTT_C
	help
	  MQTT client C++ library

	  https://eclipse.org/paho/clients/cpp/

comment "paho-mqtt-cpp needs a toolchain w/ threads and dynamic library support"
depends on BR2_STATIC_LIBS || !BR2_TOOLCHAIN_HAS_THREADS
```

## package/perl-exiftool/Config.in
```kconfig
config BR2_PACKAGE_PERL_EXIFTOOL
	bool "perl-exiftool"
	help
	  A p

	  https://metacpan.org/release/Image-ExifTool
```

## package/python-gpxpy/Config.in
```kconfig
config BR2_PACKAGE_PYTHON_GPXPY
	bool "python-gpxpy"
	help
	  This is a simple python library for parsing and manipulating
	  GPX files. GPX is an XML based format for GPS tracks.
	  
	  http://www.trackprofiler.com/gpxpy/index.html
```

## package/python-parse/Config.in
```kconfig
config BR2_PACKAGE_PYTHON_PARSE
	bool "python-parse"
	depends on BR2_PACKAGE_PYTHON
	help
	  python-parse is a package to utilize the parse web service for device tracking.
```
